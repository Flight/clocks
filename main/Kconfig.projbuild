## main/Kconfig.projbuild
```kconfig
menu "CLOCKS GPIO SETTINGS"
  config ENV_GPIO_RANGE_MIN
    int
    default 0

  config ENV_GPIO_RANGE_MAX
    int
    default 48

  config LED_GPIO
    int "Onboard LED GPIO number"
    range ENV_GPIO_RANGE_MIN ENV_GPIO_RANGE_MAX
    default 2 if IDF_TARGET_ESP32
    default 8 if IDF_TARGET_ESP32C3
    default 48 if IDF_TARGET_ESP32S3
    default 5
    help
      GPIO number (IOxx) for the onboard LED.

  config SDA_PIN
    int "SDA GPIO number"
    range ENV_GPIO_RANGE_MIN ENV_GPIO_RANGE_MAX
    default 21 if IDF_TARGET_ESP32
    default 7 if IDF_TARGET_ESP32C3
    default 21
    help
      GPIO number (IOxx) for the IC2 SDA pin.
      Check the pins schematics of you board to find it.

  config SCL_PIN
    int "SCL GPIO number"
    range ENV_GPIO_RANGE_MIN ENV_GPIO_RANGE_MAX
    default 22 if IDF_TARGET_ESP32
    default 6 if IDF_TARGET_ESP32C3
    default 22
    help
      GPIO number (IOxx) for the IC2 SCL pin.
      Check the pins schematics of you board to find it.

  config ONEWIRE_GPIO
    int "OneWire protocol GPIO number"
    range ENV_GPIO_RANGE_MIN ENV_GPIO_RANGE_MAX
    default 9
    help
      GPIO number (IOxx) for the OneWire protocol.
      Can be any GPIO, which can receive digital input.

  config TM1637_CLK_PIN
    int "TM1637 LCD screen CLK GPIO number"
    range 0 ENV_GPIO_RANGE_MAX
    default 33 if IDF_TARGET_ESP32
    default 0 if IDF_TARGET_ESP32C3
    default 33
    help
        GPIO number (IOxx) for CLK pin of TM1637 display.

  config TM1637_DIO_PIN
    int "TM1637 LCD screen DIO pin GPIO number"
    range 0 ENV_GPIO_RANGE_MAX
    default 32 if IDF_TARGET_ESP32
    default 1 if IDF_TARGET_ESP32C3
    default 32
    help
        GPIO number (IOxx) for DIO pin of TM1637 display.

  config LIGHT_SENSOR_PIN
    int "HW-072 light sensor Data Output (DO) pin GPIO number"
    range 0 ENV_GPIO_RANGE_MAX
    default 34 if IDF_TARGET_ESP32
    default 3 if IDF_TARGET_ESP32C3
    default 34
    help
        GPIO number (IOxx) for Data Output (DO) pin of HW-072 light sensor.
        Input only ports can be also used as the sensor is only outputing the data.
endmenu

menu "CLOCKS SHT3X TEMPERATURE SENSOR SETTINGS"
  config SHT3X_ADDR
    hex "I2C address of SHT3x"
    default 0x44
    help
        I2C address of SHT3x, either 0x44 or 0x45. When ADDR pin is
        grounded, choose 0x44. When ADDR pin is pulled up to VDD, choose
        0x45.
endmenu

menu "CLOCKS WI-FI SETTINGS"
  config WIFI_SSID
    string "Wi-Fi SSID"
    default "myssid"
    help
        SSID (network name).

  config WIFI_PASSWORD
    string "Wi-Fi Password"
    default "mypassword"
    help
      Wi-Fi password.
endmenu

menu "CLOCKS TIMEZONE SETTINGS"
  config TIMEZONE
    string "Timezone"
    default "CET-1CEST,M3.5.0,M10.5.0/3"
    help
      https://docs.espressif.com/projects/esp-idf/en/latest/esp32/api-reference/system/system_time.html?highlight=timezone#timezones (Default is Amsterdam)
endmenu

menu "CLOCKS WEATHER API SETTINGS"
  config WEATHER_API_KEY
    string "Weather API key (weatherapi.com)"
    help
      Go to https://www.weatherapi.com and check your key

  config WEATHER_CITY
    string "Weather City"
    help
      City to get the current weather.
    default "Amsterdam"
endmenu

menu "CLOCKS OTA UPDATE SETTINGS"
  config FIRMWARE_UPGRADE_URL
    string "Firmware upgrade endpoint URL"
    default "https://192.168.50.100:8070/clocks.bin"
    help
      URL of server which hosts the firmware image.
endmenu
```
